#include "controlOled.h"
#include "config.h"
#include <U8g2lib.h>
#include <Wire.h>

// ===== CẤU HÌNH PHẦN CỨNG =====

// ===== KHỞI TẠO ĐỐI TƯỢNG OLED =====
U8G2_SSD1306_128X64_NONAME_F_HW_I2C u8g2(U8G2_R0, U8X8_PIN_NONE, pin::OLED_SCL, pin::OLED_SDA);

// ===== DỮ LIỆU BITMAP PROGMEM =====
const unsigned char bitmap_image_1[] PROGMEM = {
	0x00, 0x00, 0x00, 0x00, 0x00, 0x00, 0x00, 0x00, 0x00, 0x00, 0x00, 0x00, 0x00, 0x00, 0x00, 0x00,
	0x00, 0x00, 0x00, 0x00, 0x00, 0x00, 0x00, 0x00, 0x00, 0xf8, 0x03, 0x00, 0x00, 0xc0, 0x1f, 0x00,
	0x00, 0xff, 0x1f, 0x00, 0x00, 0xf8, 0xff, 0x00, 0xc0, 0xff, 0x7f, 0x00, 0x00, 0xfe, 0xff, 0x03,
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	0x00, 0x00, 0x00, 0x00, 0x00, 0x00, 0x00, 0x00, 0x00, 0x00, 0x00, 0x00, 0x00, 0x00, 0x00, 0x00};

const unsigned char bitmap_image_2[] PROGMEM = {
	0x00, 0x00, 0x00, 0x00, 0x00, 0x00, 0x00, 0x00, 0x00, 0x00, 0x00, 0x00, 0x00, 0x00, 0x00, 0x00,
	0x00, 0x00, 0x00, 0x00, 0x00, 0x00, 0x00, 0x00, 0x00, 0x00, 0x00, 0x00, 0x00, 0x00, 0x00, 0x00,
	0x00, 0x00, 0x00, 0x00, 0x00, 0x00, 0x00, 0x00, 0x00, 0x00, 0x00, 0x00, 0x00, 0x00, 0x00, 0x00,
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	0x00, 0x00, 0x00, 0x00, 0x00, 0x00, 0x00, 0x00, 0x00, 0x00, 0x00, 0x00, 0x00, 0x00, 0x00, 0x00};

// ===== BIẾN NỘI BỘ =====
static SemaphoreHandle_t textMutex = NULL;
static String pendingText = "Minny";
static volatile bool hasNewText = true;
static String shownText;

static unsigned long lastTimeOled = 0;
static int textWidth = 0;
static int scrollPos = 0;

// Cấu hình mắt
static unsigned long lastTimeSleep = 0;
static bool isSleep = false;
static int maxTimeSleep = 3000;

static unsigned long lastRandom = 0;
static long randomTime = 1000;

static int randomX = 24;
static int randomY = 5;

void oledTask(void *pvParameters);
void updateOled();

// ===== HÀM KHỞI TẠO MÀN HÌNH OLED =====
void initOled()
{
	textMutex = xSemaphoreCreateMutex();
	u8g2.setBusClock(oled::I2C_CLOCK_HZ);
	u8g2.begin();
	u8g2.enableUTF8Print();
	xTaskCreatePinnedToCore(oledTask, task::OLED.name, task::OLED.stack, NULL, task::OLED.prio, NULL, task::OLED.core);
}

// ===== HÀM CẬP NHẬT CHỮ LÊN OLED =====
void oledSetText(const String &text)
{
	xSemaphoreTake(textMutex, portMAX_DELAY);
	pendingText = text;
	hasNewText = true;
	xSemaphoreGive(textMutex);
}

// ===== OLED TASK =====
void oledTask(void *pvParameters)
{
	for (;;)
	{
		updateOled();
		vTaskDelay(pdMS_TO_TICKS(10));
	}
}

// ===== HÀM CẬP NHẬT MÀN HÌNH =====
void updateOled()
{
	unsigned long currentTime = millis();

	lastTimeOled = currentTime;

	u8g2.clearBuffer();
	u8g2.setFont(u8g2_font_unifont_t_vietnamese1);

	// Cập nhật chữ lên màn hình
	if (hasNewText)
	{
		xSemaphoreTake(textMutex, portMAX_DELAY);
		shownText = pendingText;
		hasNewText = false;
		xSemaphoreGive(textMutex);

		textWidth = u8g2.getUTF8Width(pendingText.c_str());
		scrollPos = (textWidth > oled::WIDTH) ? oled::WIDTH : (oled::WIDTH - textWidth) / 2;
	}

	// Hiệu ứng chữ chạy
	if (textWidth > oled::WIDTH)
	{
		scrollPos -= 4;
		if (scrollPos < -textWidth)
		{
			scrollPos = oled::WIDTH;
		}
	}

	u8g2.setCursor(scrollPos, 58);
	u8g2.print(pendingText);

	// Hiệu ứng gương mặt
	if (currentTime - lastRandom >= randomTime)
	{
		randomX = random(24, 41);
		randomY = random(5, 15);
		randomTime = random(800, 1200);
		lastRandom = currentTime;
	}

	if (currentTime - lastTimeSleep >= maxTimeSleep)
	{
		isSleep = !isSleep;
		maxTimeSleep = (isSleep) ? 200 : 3000;
		lastTimeSleep = currentTime;
	}

	u8g2.drawXBMP(randomX, randomY, 64, 32, (isSleep) ? bitmap_image_2 : bitmap_image_1);

	u8g2.sendBuffer();
}
